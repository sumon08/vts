## vtd/adapter/Kconfig
```kconfig
menu "Adapter Configuration"

	config NO_OF_READ_FD
		int "CONFIG_NO_OF_READ_FD"
		default 16

	config NO_OF_WRITE_FD
		int "CONFIG_NO_OF_WRITE_FD"
		default 16

	config TEST_ON_LINUX
		int "CONFIG_TEST_ON_LINUX"
		default 0

	config TEST_ON_NUTTX
		int "CONFIG_TEST_ON_NUTTX"
		default 0
endmenu
```

## vtd/board/vts-v2f401rc/vts/defconfig
```kconfig
CONFIG_HOST_LINUX=y
CONFIG_APPS_DIR="../apps"
CONFIG_BUILD_FLAT=y
CONFIG_RAW_BINARY=y
CONFIG_DEBUG_ALERT=y
CONFIG_ARCH_HAVE_STACKCHECK=y
CONFIG_ARCH_HAVE_HEAPCHECK=y
CONFIG_ARCH_HAVE_CUSTOMOPT=y
CONFIG_DEBUG_FULLOPT=y
CONFIG_ARCH_ARM=y
CONFIG_ARCH="arm"
CONFIG_ARCH_CHIP_STM32=y
CONFIG_ARCH_CORTEXM4=y
CONFIG_ARCH_FAMILY="armv7-m"
CONFIG_ARCH_CHIP="stm32"
CONFIG_ARCH_HAVE_CMNVECTOR=y
CONFIG_ARCH_HAVE_FPU=y
CONFIG_ARCH_FPU=y
CONFIG_ARM_HAVE_MPU_UNIFIED=y
CONFIG_ARMV7M_TOOLCHAIN_CODESOURCERYL=y
CONFIG_ARMV7M_HAVE_STACKCHECK=y
CONFIG_ARCH_CHIP_STM32F401RC=y
CONFIG_STM32_FLASH_CONFIG_DEFAULT=y
CONFIG_STM32_STM32F4XXX=y
CONFIG_STM32_STM32F401xBC=y
CONFIG_STM32_STM32F401=y
CONFIG_STM32_HAVE_OTGFS=y
CONFIG_STM32_HAVE_USART6=y
CONFIG_STM32_HAVE_TIM1=y
CONFIG_STM32_HAVE_TIM3=y
CONFIG_STM32_HAVE_TIM4=y
CONFIG_STM32_HAVE_TIM5=y
CONFIG_STM32_HAVE_TIM9=y
CONFIG_STM32_HAVE_TIM10=y
CONFIG_STM32_HAVE_TIM11=y
CONFIG_STM32_HAVE_I2C2=y
CONFIG_STM32_HAVE_I2C3=y
CONFIG_STM32_HAVE_SPI2=y
CONFIG_STM32_HAVE_SPI3=y
CONFIG_STM32_HAVE_I2S3=y
CONFIG_STM32_USART1=y
CONFIG_STM32_USART6=y
CONFIG_STM32_JTAG_SW_ENABLE=y
CONFIG_STM32_USART=y
CONFIG_STM32_SERIALDRIVER=y
CONFIG_STM32_USART1_SERIALDRIVER=y
CONFIG_STM32_USART6_SERIALDRIVER=y
CONFIG_ARCH_TOOLCHAIN_GNU=y
CONFIG_ARCH_HAVE_IRQPRIO=y
CONFIG_ARCH_HAVE_VFORK=y
CONFIG_ARCH_HAVE_MPU=y
CONFIG_ARCH_HAVE_PROGMEM=y
CONFIG_ARCH_HAVE_RESET=y
CONFIG_ARCH_HAVE_FETCHADD=y
CONFIG_ARCH_STACKDUMP=y
CONFIG_ARCH_HAVE_RAMVECTORS=y
CONFIG_BOARD_LOOPSPERMSEC=8499
CONFIG_ARCH_HAVE_INTERRUPTSTACK=y
CONFIG_ARCH_INTERRUPTSTACK=2048
CONFIG_ARCH_HAVE_HIPRI_INTERRUPT=y
CONFIG_BOOT_RUNFROMFLASH=y
CONFIG_RAM_START=0x20000000
CONFIG_RAM_SIZE=65536
CONFIG_ARCH_BOARD_VTSV2F401RC=y
CONFIG_ARCH_BOARD="vts-v2f401rc"
CONFIG_DISABLE_OS_API=y
CONFIG_ARCH_HAVE_TICKLESS=y
CONFIG_USEC_PER_TICK=10000
CONFIG_ARCH_HAVE_TIMEKEEPING=y
CONFIG_START_YEAR=2018
CONFIG_START_MONTH=7
CONFIG_START_DAY=26
CONFIG_MAX_WDOGPARMS=2
CONFIG_PREALLOC_WDOGS=8
CONFIG_WDOG_INTRESERVE=1
CONFIG_PREALLOC_TIMERS=4
CONFIG_INIT_ENTRYPOINT=y
CONFIG_USER_ENTRYPOINT="vts_main"
CONFIG_RR_INTERVAL=200
CONFIG_TASK_NAME_SIZE=0
CONFIG_MAX_TASKS=16
CONFIG_SCHED_WAITPID=y
CONFIG_NPTHREAD_KEYS=4
CONFIG_PTHREAD_MUTEX_ROBUST=y
CONFIG_DEV_CONSOLE=y
CONFIG_SDCLONE_DISABLE=y
CONFIG_NFILE_DESCRIPTORS=32
CONFIG_NFILE_STREAMS=32
CONFIG_NAME_MAX=32
CONFIG_PRIORITY_INHERITANCE=y
CONFIG_SEM_PREALLOCHOLDERS=16
CONFIG_SEM_NNESTPRIO=16
CONFIG_BOARD_INITIALIZE=y
CONFIG_SIG_SIGUSR1=1
CONFIG_SIG_SIGUSR2=2
CONFIG_SIG_SIGALARM=3
CONFIG_SIG_SIGCONDTIMEDOUT=16
CONFIG_PREALLOC_MQ_MSGS=4
CONFIG_MQ_MAXMSGSIZE=32
CONFIG_IDLETHREAD_STACKSIZE=1024
CONFIG_USERMAIN_STACKSIZE=2048
CONFIG_PTHREAD_STACK_MIN=256
CONFIG_PTHREAD_STACK_DEFAULT=2048
CONFIG_DISABLE_POLL=y
CONFIG_DEV_NULL=y
CONFIG_ARCH_HAVE_I2CRESET=y
CONFIG_ARCH_HAVE_SPI_BITORDER=y
CONFIG_SPI=y
CONFIG_SPI_EXCHANGE=y
CONFIG_MODEM=y
CONFIG_MODEM_SIM868=y
CONFIG_GPS=y
CONFIG_GPS_SIM68=y
CONFIG_PIPES=y
CONFIG_DEV_PIPE_MAXSIZE=1024
CONFIG_DEV_PIPE_SIZE=1024
CONFIG_DEV_FIFO_SIZE=1024
CONFIG_SERIAL=y
CONFIG_SERIAL_CONSOLE=y
CONFIG_MCU_SERIAL=y
CONFIG_STANDARD_SERIAL=y
CONFIG_ARCH_HAVE_SERIAL_TERMIOS=y
CONFIG_USART1_SERIAL_CONSOLE=y
CONFIG_USART1_SERIALDRIVER=y
CONFIG_USART6_SERIALDRIVER=y
CONFIG_USART1_RXBUFSIZE=256
CONFIG_USART1_TXBUFSIZE=256
CONFIG_USART1_BAUD=115200
CONFIG_USART1_BITS=8
CONFIG_USART1_PARITY=0
CONFIG_USART1_2STOP=0
CONFIG_USART6_RXBUFSIZE=256
CONFIG_USART6_TXBUFSIZE=256
CONFIG_USART6_BAUD=115200
CONFIG_USART6_BITS=8
CONFIG_USART6_PARITY=0
CONFIG_USART6_2STOP=0
CONFIG_SYSLOG_WRITE=y
CONFIG_SYSLOG_SERIAL_CONSOLE=y
CONFIG_SYSLOG_CONSOLE=y
CONFIG_FS_READABLE=y
CONFIG_FS_WRITABLE=y
CONFIG_FS_MQUEUE_MPATH="/var/mqueue"
CONFIG_FS_FAT=y
CONFIG_FS_TMPFS=y
CONFIG_FS_TMPFS_BLOCKSIZE=512
CONFIG_FS_TMPFS_DIRECTORY_ALLOCGUARD=64
CONFIG_FS_TMPFS_DIRECTORY_FREEGUARD=128
CONFIG_FS_TMPFS_FILE_ALLOCGUARD=512
CONFIG_FS_TMPFS_FILE_FREEGUARD=1024
CONFIG_NXFONTS_PACKEDMSFIRST=y
CONFIG_MM_REGIONS=2
CONFIG_BUILTIN=y
CONFIG_STDIO_BUFFER_SIZE=64
CONFIG_STDIO_LINEBUFFER=y
CONFIG_NUNGET_CHARS=2
CONFIG_LIBC_LONG_LONG=y
CONFIG_EOL_IS_EITHER_CRLF=y
CONFIG_ARCH_LOWPUTC=y
CONFIG_LIB_RAND_ORDER=1
CONFIG_LIB_HOMEDIR="/"
CONFIG_LIBC_TMPDIR="/tmp"
CONFIG_LIBC_MAX_TMPFILE=32
CONFIG_POSIX_SPAWN_PROXY_STACKSIZE=1024
CONFIG_TASK_SPAWN_DEFAULT_STACKSIZE=2048
CONFIG_ARCH_HAVE_TLS=y
CONFIG_TLS=y
CONFIG_TLS_LOG2_MAXSTACK=12
CONFIG_TLS_NELEM=1
CONFIG_LIB_SENDFILE_BUFSIZE=512
CONFIG_HAVE_CXX=y
CONFIG_BUILTIN_PROXY_STACKSIZE=1024
CONFIG_EXAMPLES_VTS=y
CONFIG_VTS_CXXINITIALIZE=y
CONFIG_EXAMPLES_VTS_PRIORITY=100
CONFIG_EXAMPLES_VTS_STACKSIZE=2048
CONFIG_DEBUG_SERIAL_PATH="/dev/ttyS0"
CONFIG_FSUTILS_MKFATFS=y
CONFIG_HAVE_CXXINITIALIZE=y
CONFIG_SYSTEM_READLINE=y
CONFIG_READLINE_ECHO=y
CONFIG_C99_BOOL8=n
```

## vtd/board/vts/Kconfig
```kconfig
#
# For a description of the syntax of this configuration file,
# see the file kconfig-language.txt in the NuttX tools repository.
#

config EXAMPLES_VTS
	bool "VTS app"
	default n
	---help---
		Enable the VTS App

if EXAMPLES_VTS

config EXAMPLES_VTS_PROGNAME
	string "Program name"
	default "vts"
	depends on BUILD_KERNEL
	---help---
		This is the name of the program that will be use when the NSH ELF
		program is installed.

config VTS_CXXINITIALIZE
	bool "C++ Initialization"
	default y
	depends on HAVE_CXX && HAVE_CXXINITIALIZE
	---help---
		By default, if CONFIG_HAVE_CXX and CONFIG_HAVE_CXXINITIALIZE are
		defined, then this example will call the NuttX function to
		initialize static C++ constructors.  This option may be disabled,
		however, if that static initialization was performed elsewhere.

config EXAMPLES_VTS_PRIORITY
	int "VTS task priority"
	default 100

config EXAMPLES_VTS_STACKSIZE
	int "VTS stack size"
	default 2048

config DEBUG_SERIAL_PATH
	string "Serial character device map"
	default "/dev/ttyS0"
	---help---
		Nuttx maps the US[A]RT to character device in /dev/ directory as ttyS0, ttyS1.


endif
```

## vtd/board/vts_drivers/drivers/vts/Kconfig
```kconfig
#
# For a description of the syntax of this configuration file,
# see the file kconfig-language.txt in the NuttX tools repository.
#

config ENGINE_SENSOR
	bool "Enable VTS Engine Sensor Driver"
	default y


config PANIC_SENSOR
	bool "Enable VTS Panic Sensor Driver"
	default y

config AC_SENSOR
	bool "Enable VTS AC Sensor Driver"
	default y

config LOUDHORN
	bool "Enable VTS LOUDHORN Driver"
	default y

config BATTERY_SENSOR
	bool "Enable VTS Car Battery Sensor Driver"
	default y

config SENSORS_DEBUG
	bool "Debug sensor drivers"
	default n
	---help---
		Allow the vts sensor drivers to print debug information.
```

## vtd/core/Kconfig
```kconfig
#
# For a description of the syntax of this configuration file,
# see the file kconfig-language.txt in the NuttX tools repository.
#




config VTS_PROGNAME
	string "Program name"
	default "vts"
	---help---
		This is the name of the program that will be use when the NSH ELF
		program is installed.

menu "Features"

	config ENABLE_MODEM
		bool "Enable Modem"
		default "y"

	config ENABLE_GPS
		bool "Enable GPS"
		default "y"
endmenu


source "command/Kconfig"
source "event/Kconfig"
source "module/Kconfig"
source "source/Kconfig"
source "../adapter/Kconfig"
source "protocol/Kconfig"
```

## vtd/core/command/Kconfig
```kconfig
menu "Command Manager Configuration"

	config	HAVE_USB_DEBUG
		bool "Enable USB debug port. Currently not supported. Have no impact on code."
		default n

	config 	REPORT_DEVICE_COMMAND_TO_CONSOLE
		bool "Enable this option to get device generated command to serial port"
		default y

	config 	REPORT_DEVICE_COMMAND_TO_TCP
		bool "Enable this option to get device generated command to serial port"
		default y
endmenu
```

## vtd/core/event/Kconfig
```kconfig
menu "Event Related Configuration"

	config EVENT_REGISTRY_AT_FLASH
		bool "CONFIG_EVENT_REGISTRY_AT_FLASH"
		default y
	menu "Configure various event id offset value"
		
		config EVENT_ID_BASE
			hex "CONFIG_EVENT_ID_BASE"
			default 0x200
		
		config EVENT_NAME_LENGTH
			int "Maximum length of name of event"
			default "16"


		menu "Offset value for deiffent event id"
			config LOCATION_EVENT_OFFSET
				hex "CONFIG_GPS_EVENT_OFFSET"
				default 0x01

			config ENGINE_EVENT_OFFSET
				hex "CONFIG_ENGINE_EVENT_OFFSET"
				default 0x02

			config AC_EVENT_OFFSET
				hex "CONFIG_ENGINE_EVENT_OFFSET"
				default 0x03

			config PANIC_EVENT_OFFSET
				hex "CONFIG_PANIC_EVENT_OFFSET"
				default 0x04

			config BATTERY_REMOVAL_EVENT_OFFSET
				hex "CONFIG_BATTERY_REMOVAL_EVENT_OFFSET"
				default 0x05

			config BATTERY_LEVEL_EVENT_OFFSET
				hex "CONFIG_BATTERY_LEVEL_EVENT_OFFSET"
				default 0x06

			config OVERSPEED_EVENT_OFFSET
				hex "CONFIG_OVERSPEED_EVENT_OFFSET"
				default 0x07
		endmenu
	endmenu	
endmenu
```

## vtd/core/module/Kconfig
```kconfig
menu "Module Configuartion"
	menu "Feature Specific Module id Configuration"
		config MODULE_ID
			bool "Configure Feature Specific module id"
			default y
			
		if MODULE_ID
			config GPS_MODULE_ID
				hex "CONFIG_GPS_MODULE_ID"
				default 0x01

			config ENGINE_MODULE_ID
				hex "CONFIG_ENGINE_MODULE_ID"
				default 0x02

			config AC_MODULE_ID
				hex "CONFIG_AC_MODULE_ID"
				default 0x03

			config DOOR_MODULE_ID
				hex "CONFIG_DOOR_MODULE_ID"
				default 0x04

			config PANIC_MODULE_ID
				hex "CONFIG_PANIC_MODULE_ID"
				default 0x05

			config OVERSPEED_MODULE_ID
				hex "CONFIG_OVERSPEED_MODULE_ID"
				default 0x06

			config GEOFENCE_MODULE_ID
				hex "CONFIG_GEOFENCE_MODULE_ID"
				default 0x07

			config AUDIOSPY_MODULE_ID
				hex "CONFIG_AUDIOSPY_MODULE_ID"
				default 0x08

			config IMAGE_MODULE_ID
				hex "CONFIG_IMAGE_MODULE_ID"
				default 0x09

			config FUEL_MODULE_ID
				hex "CONFIG_FUEL_MODULE_ID"
				default 0x0a

			config LOUDHORN_MODULE_ID
				hex "CONFIG_LOUDHORN_MODULE_ID"
				default 0x0b

			config BATTERY_MODULE_ID
				hex "CONFIG_BATTERY_MODULE_ID"
				default 0x0c

			config USER_MODULE_ID
				hex "CONFIG_USER_MODULE_ID"
				default 0x0d

			config FOTA_MODULE_ID
				hex "CONFIG_FOTA_MODULE_ID"
				default 0x0e

			config POWER_MODULE_ID
				hex "CONFIG_POWER_MODULE_ID"
				default 0x0e
		endif
	endmenu

	menu "MODULE DEBUG"
		config DEBUG_LEVEL
			int "CONFIG_DEBUG_LEVEL"
			 default DEBUG_LEVEL_LOW

		config DEBUG_LEVEL_HIGH
			int "CONFIG_DEBUG_LEVEL_HIGH"
			default 3

		config DEBUG_LEVEL_MID
			int "CONFIG_DEBUG_LEVEL_MID"
			default 2

		config DEBUG_LEVEL_LOW
			int "CONFIG_DEBUG_LEVEL_LOW"
			default 1
	endmenu
endmenu
```

## vtd/core/protocol/Kconfig
```kconfig
menu "Protocol Configuration" 
    config HAVE_PACKET_PADDING_SCHEAM
        bool "Select this macro if packet data is padded."
        default y
    
    config MAKE_PACKET_BUFFER_OVERFLOW_RETURN_VALUE
        hex "Make packet function return value in case of buffer overflowed case hit."
        default 0x07E8
    
    config MAKE_PACKET_MAX_VALID_RETURN_VALUE 
        hex "Maximum return value from make function."
        default 0x0400
    
    menu "Configure Packet version Specific constant settings"
		config PACKET_VERSION_4
			bool "Configure Packet version 4 Specific constant settings"
			default y

		if PACKET_VERSION_4

			config START_STOP_FLAG
				hex "CONFIG_START_STOP_FLAG"
				default 0xf9

			config CONTROL_CHANNEL_ID
				hex "CONFIG_CONTROL_CHANNEL_ID"
				default 0x00

			config GPS_CHANNEL_ID
				hex "CONFIG_GPS_CHANNEL_ID"
				default 0x01

			config ENGINE_CHANNEL_ID
				hex "CONFIG_ENGINE_CHANNEL_ID"
				default 0x02

			config AC_CHANNEL_ID
				hex "CONFIG_AC_CHANNEL_ID"
				default 0x03

			config DOOR_CHANNEL_ID
				hex "CONFIG_DOOR_CHANNEL_ID"
				default 0x04

			config PANIC_CHANNEL_ID
				hex "CONFIG_PANIC_CHANNEL_ID"
				default 0x05

			config OVERSPEED_CHANNEL_ID
				hex "CONFIG_OVERSPEED_CHANNEL_ID"
				default 0x06

			config GEOFENCE_CHANNEL_ID
				hex "CONFIG_GEOFENCE_CHANNEL_ID"
				default 0x07

			config AUDIOSPY_CHANNEL_ID
				hex "CONFIG_AUDIOSPY_CHANNEL_ID"
				default 0x08

			config IMAGE_CHANNEL_ID
				hex "CONFIG_IMAGE_CHANNEL_ID"
				default 0x09

			config FUEL_CHANNEL_ID
				hex "CONFIG_FUEL_CHANNEL_ID"
				default 0x0a

			config LOUDHORN_CHANNEL_ID
				hex "CONFIG_LOUDHORN_CHANNEL_ID"
				default 0x0b

			config BATTERY_CHANNEL_ID
				hex "CONFIG_BATTERY_CHANNEL_ID"
				default 0x0c

			config USER_CHANNEL_ID
				hex "CONFIG_USER_CHANNEL_ID"
				default 0x0d

			config FOTA_CHANNEL_ID
				hex "CONFIG_FOTA_CHANNEL_ID"
				default 0x0e

			config POWER_CHANNEL_ID
				hex "CONFIG_POWER_CHANNEL_ID"
				default 0x0f
		endif
	endmenu	

    source "protocol/default/Kconfig"

    source "protocol/engine/Kconfig"
    
endmenu
```

## vtd/core/protocol/default/Kconfig
```kconfig
menu "Parser Error Id List"

    config BAD_CHECKSUM_ERROR_ID
        hex "Id for bad checksum error."
        default 0x01
        
    config BAD_FORMAT_ERROR_ID
        hex "Id for bad format error."
        default 0x02

    config DATA_LENGTH_ERROR_ID
        hex "Id for data length error."
        default 0x03

    config DATA_LENGTH_MISSMATCH_ERROR_ID
        hex "Id for data length missmatch error."
        default 0x04
    
    config BAD_ENCRYPTION_ERROR_ID
        hex "Id for bad encryption error"
        default 0x05
    
    config IN_SUFFICIENT_PARAM_ERROR_ID
        hex "Id for insufficient parameter error."
        default 0x06

    config INVALID_PARAM_ERROR_ID
        hex "Id for Invalid parameter error"
        default 0x07

    config NOT_IMPLEMENTED_ERROR_ID
        hex "Id for not implemented error."
        default 0x08

    config PARAM_OVERLOADED_ERROR_ID
        hex "Id for parameter overloaded."
        default 0x09

    config UNKNOWN_COMMAND_ERROR_ID
        hex "Id for unknown command error."
        default 0x0A;

    config BUFFER_OVERLOAD_ERROR_ID
        hex "Id for buffer error id."
        default 0x0B

    config PACKET_OVERLOAD_ERROR_ID
        hex "Id for large data packet error id."
        default 0x0C

    config BAD_PARSER_ERROR_ID
        hex "Id for large data packet error id."
        default 0x0D
    
    config UNKNOWN_REPLY_ERROR_ID
        hex "Id for large data packet error id."
        default 0x0E


endmenu
```

## vtd/core/protocol/engine/Kconfig
```kconfig
menu "Engine Command List"

    config TEST_COMMAND_ID
        hex "Test command. This command do nothing. just reply ack"
        default "0x40"


    config ECHO_COMMAND_ID
        hex "Echo command. This command take one parameter as string end after execution return the text."
        default "0x41"


    config COMMAND_ENGINE_STATUS_ID
        hex "Engine status command. This command carry engine status command at a specific time."
        default "0x01"
        
endmenu
```

## vtd/core/source/Kconfig
```kconfig
menu "Source Code Related Configuration"
	config CONFIG_HEAP_SIZE
	int "Configure Heap Size for VTS, default set to 20KB"
	default 20480

	config EVENT_FIFO_MAX_SIZE
	int "Maximum size of Event Manager Command Buffer FIFO"
	default 100
endmenu
```
